## Kconfig
```kconfig
# January 22, 2025, 13:35:59
# larson.li
# Project configuration initialization

mainmenu "uniRTOS configuration"

orsource "qos_applications/Kconfig"
orsource "qos_components/Kconfig"
```

## qos_applications/Kconfig
```kconfig
# January 22, 2025, 13:35:59
# larson.li
# Project configuration initialization

menu "UniRTOS Applications"

config QAPP_UNIRTOS_STD_FUNC
    bool "Standard AT command implementation"
    select QOSA_AT_PARSER_FUNC

orsource "unirtos_std/Kconfig"

endmenu
```

## qos_components/system/modem/Kconfig.modem
```kconfig
orsource "config/Kconfig.modem.at"
orsource "config/Kconfig.modem.sim"
orsource "config/Kconfig.modem.usbnet"
orsource "config/Kconfig.modem.network"
orsource "config/Kconfig.modem.datacall"
```

## qos_components/system/modem/config/Kconfig.modem.usbnet
```kconfig
# Copyright (C) 2023 UniRTOS.
# All rights reserved.
#

menu "usbnet"

config QOSA_USBNET_MBIM
    bool "MBIM"
    default n

config QOSA_USBNET_NCM
    bool "NCM"
    default n

config QOSA_USBNET_LIGHT_MODE
    bool "Light Mode"
    default n

endmenu
```
